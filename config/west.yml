## config/west.yml
```yaml
manifest:
  defaults:
    remote: cormoran
    revision: main
  remotes:
    - name: cormoran
      url-base: https://github.com/cormoran
    - name: caksoylar
      url-base: https://github.com/caksoylar
  projects:
    # DYA Studio (Custom Studio Protocol) 対応の ZMK fork
    - name: zmk
      revision: main+dya
      import:
        file: app/west.yml
    - name: zephyr
      revision: v4.1.0+zmk-fixes+nrf-half-duplex-uart
      clone-depth: 1
      import:
        name-blocklist:
          - ci-tools
          - hal_altera
          - hal_cypress
          - hal_infineon
          - hal_microchip
          - hal_nxp
          - hal_openisa
          - hal_xtensa
          - hal_st
          - hal_ti
          - loramac-node
          - mcuboot
          - mcumgr
          - net-tools
          - openthread
          - edtt
          - trusted-firmware-m
    # コアモジュール
    - name: zmk-feature-custom-settings
    - name: zmk-feature-fast-keymap
    # Keymap / Macro / Combo
    - name: zmk-feature-runtime-macro
    - name: zmk-feature-runtime-combo
    - name: zmk-feature-input-stream
    - name: zmk-feature-module-physical-layout
    - name: zmk-behavior-runtime-sensor-rotate
    # Trackball
    - name: zmk-driver-pmw3610-with-custom-studio-rpc
    - name: zmk-module-runtime-input-processor
    # Connection
    - name: zmk-module-ble-management
    - name: zmk-feature-default-layer
      revision: codex/custom-rpc-rewrite
    - name: zmk-feature-os-detection
    # Settings
    - name: zmk-module-settings-rpc
    # 診断
    - name: zmk-feature-device-info
    - name: zmk-feature-watchdog
    - name: zmk-feature-kscan-diagnostics
    # RGB LED
    - name: zmk-rgbled-widget
      remote: caksoylar
      revision: main
  self:
    path: config
```
